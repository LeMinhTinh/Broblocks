## QT/SS_LinuxSampleCode/ss-src-2/hello-module/Kconfig
```kconfig
#
# hello module configuration
#

menu "Hello Module support"

config HELLO
	tristate "Include Hello module?"
	---help---
	  Linux Kernel Module demonstration - Hello

endmenu
```
